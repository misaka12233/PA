## nemu/src/memory/Kconfig
```kconfig
menu "Memory Configuration"

config MBASE
  hex "Memory base address"
  default 0x0        if ISA_x86
  default 0x80000000

config MSIZE
  hex "Memory size"
  default 0x8000000

config PC_RESET_OFFSET
  hex "Offset of reset vector from the base of memory"
  default 0x100000 if ISA_x86
  default 0

choice
  prompt "Physical memory definition"
  default PMEM_GARRAY
config PMEM_MALLOC
  bool "Using malloc()"
config PMEM_GARRAY
  depends on !TARGET_AM
  bool "Using global array"
endchoice

config MEM_RANDOM
  depends on MODE_SYSTEM && !DIFFTEST && !TARGET_AM
  bool "Initialize the memory with random values"
  default y
  help
    This may help to find undefined behaviors.

config MTRACE
  depends on TRACE && TARGET_NATIVE_ELF && ENGINE_INTERPRETER
  bool "Enable memory tracer"
  default y

config MTRACE_START
  depends on MTRACE
  hex "memory tracer start from"
  default 0x80000000

config MTRACE_END
  depends on MTRACE
  hex "memory tracer end at"
  default 0x87ffffff

endmenu #MEMORY
```
